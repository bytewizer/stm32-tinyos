## meta-stm32mp15x/conf/layer.conf
```bitbake
# We have a conf and classes directory, add to BBPATH
BBPATH .= ":${LAYERDIR}"

# We have recipes-* directories, add to BBFILES
BBFILES += "${LAYERDIR}/recipes-*/*/*.bb \
	${LAYERDIR}/recipes-*/*/*.bbappend"

BBFILE_COLLECTIONS += "meta-stm32mp15x"
BBFILE_PATTERN_meta-stm32mp15x = "^${LAYERDIR}/"
BBFILE_PRIORITY_meta-stm32mp15x= "10"

LAYERDEPENDS_meta-stm32mp15x = "core"
LAYERSERIES_COMPAT_meta-stm32mp15x = "kirkstone"

# Set variable to get the location of the layer
STM32MP15X_BASE := '${LAYERDIR}'
```
